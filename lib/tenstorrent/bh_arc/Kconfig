## lib/tenstorrent/bh_arc/Kconfig
```kconfig
# Copyright (c) 2024 Tenstorrent AI ULC
# SPDX-License-Identifier: Apache-2.0

config TT_BH_ARC
	bool "Blackhole ARC firmware library"
	select FLASH
	select FLASH_PAGE_LAYOUT
	select TT_BOOT_FS
	select NANOPB
	select CRC
	select I2C
	select I2C_TARGET
	select SMBUS_TARGET
	select ZBUS
	help
	  This option enables the Blackhole ARC firmware library.

if TT_BH_ARC

config TT_BH_ARC_NUM_MSG_CODES
	int "Number of message codes"
	default 199
	help
	  The number of message codes

config TT_SHELL
	bool "Tenstorrent Blackhole shell driver"
	depends on SHELL
	default y
	help
	  Enable the Tenstorrent Shell

config TT_BH_ARC_FAN_CTRL_ALPHA
	int "Fan control alpha value"
	default 50
	help
	  Value of alpha for filtering fan curve input temp

config TT_BH_ARC_FAN_CTRL_GDDR_TEMP
	bool "Use GDDR temp as fan curve input"
	default y
	help
	  Enable to use GDDR temp in fan speed calculation

config TT_BH_ARC_I2C_TIMEOUT
	bool "Time out if I2C transaction exceeds given duration"
	default y
	help
	  Timeout if I2C transaction exceeds set duration. This can be useful
	  to recover from bus stalls. If the TX FIFO for the I2C controller
	  remains full for this timeout, the I2C controller will attempt to
	  recover the bus by sending 16 SCL pulses while holding SDA low.

config TT_BH_ARC_I2C_TIMEOUT_DURATION
	int "Timeout for I2C transactions in milliseconds"
	default 25
	depends on TT_BH_ARC_I2C_TIMEOUT
	help
	  Timeout for I2C transactions in milliseconds. If the TX FIFO for the I2C controller
	  remains full for this timeout, the I2C controller will attempt to recover the bus by
	  sending 16 SCL pulses while holding SDA low.

config TT_SMC_RECOVERY
	bool "build smc recovery image"
	help
	  Enable to build smc recovery image.

config TT_BH_ARC_WDT_FEED_INTERVAL
	int "Feed interval for watchdog (ms)"
	default 250
	help
	  Interval to feed watchdog within firmware

config TT_BH_ARC_SCRATCHPAD_SIZE
	int "Size of scratchpad memory in bytes"
	default 512
	help
	  Size of scratchpad memory in bytes. This is mainly used as a temporary buffer for
	  loading images from SPI flash.

config TT_BH_ARC_DMFW_PING_TIMEOUT
	int "Timeout for DMFW ping in milliseconds"
	default 200
	help
	  Timeout for DMFW ping in milliseconds. If the DMFW does not respond within this time,
	  the ping will be considered failed.

config TT_BH_ARC_CAPTURE_BUFFER_BYTES
	int "Shared host capture buffer size in bytes (power + clock_pattern)"
	default 147456
	range 4096 524288
	help
	  Single CSM/SRAM region for simultaneous VCORE TDP (dense uint16 centiwatts) and
	  AICLK clock_pattern (sparse 6-byte events). Default 147456 (144 KiB).

config TT_BH_ARC_POWER_CAPTURE_BYTES
	int "Bytes at the start of the capture buffer for power_pattern samples"
	default 98304
	range 2 524288
	help
	  Must be even. Each sample is 2 bytes (centiwatts). Remaining bytes in
	  TT_BH_ARC_CAPTURE_BUFFER_BYTES hold clock_pattern events (6 bytes each).
	  Default 98304 (96 KiB) => 49152 samples at 1 ms (~49 s) with 49152 bytes
	  (~8192 events) for clock_pattern.

config TT_BH_ARC_CLOCK_PATTERN_RING_BUFFER
	bool "Clock pattern ring buffer (keep newest samples when full)"
	default n
	help
	  When the data row range is full, wrap to row 1 and overwrite. Sequence numbers still
	  increase monotonically (until uint16 wrap), so host tools sort by sample index for time
	  order. When disabled, recording stops when full (legacy).

config TT_BH_ARC_CLOCK_SAMPLE_DIVISOR
	int "Clock pattern: record one row every N DVFS ticks (1 ms each)"
	default 50
	range 1 1000
	help
	  1 = one row per millisecond. For example 13 gives ~10 s wall time in 771 rows
	  (771 * 13 ms). Sequence numbers in the grid count stored samples, not elapsed ms.

config TT_BH_ARC_POWER_PATTERN_RING_BUFFER
	bool "Power pattern ring buffer (keep newest samples when full)"
	default y
	help
	  When full, wrap to index 0 and overwrite oldest samples. When disabled, capture
	  stops when the linear buffer is full.

config TT_BH_ARC_POWER_SAMPLE_DIVISOR
	int "Power pattern: record one sample every N DVFS ticks (1 ms each)"
	default 1
	range 1 1000
	help
	  1 = one sample per millisecond. Time for index i is i * divisor ms.

module = BH_ARC
module-str = bh_arc
source "subsys/logging/Kconfig.template.log_config"

endif
```

## west.yml
```yaml
# Copyright (c) 2024 Tenstorrent AI ULC
# SPDX-License-Identifier: Apache-2.0

manifest:
  remotes:
    - name: tenstorrent
      url-base: https://github.com/tenstorrent
    - name: tenstorrent-forks
      url-base: https://github.com/tenstorrent-forks
    - name: openbmc
      url-base: https://github.com/openbmc

  # zephyr-keep-sorted-start re(^\s+\- name:)
  projects:
    - name: libpldm
      remote: openbmc
      path: modules/lib/libpldm
      revision: 1c4a11442648a7ac670167b4d306a70376a35cc2
    - name: librpmi
      remote: tenstorrent-forks
      path: modules/lib/librpmi
      revision: 23e94f7007731e91be4de7c1d9c8c48b2173f6a2
    - name: tf-psa-crypto
      # Required by Mbed TLS 4.x (MCUboot sysbuild). Explicit because the
      # pinned zephyr-fork revision does not import this module yet, while
      # local builds often use a newer Zephyr that expects it.
      url: https://github.com/zephyrproject-rtos/tf-psa-crypto
      revision: dc575a2ddcc8cb16275d24c42a52eaf79ebe2231
      path: modules/crypto/tf-psa-crypto
    - name: zephyr
      remote: tenstorrent
      repo-path: zephyr-fork
      revision: 68672ece76e299ae6f1711586fb4756390ffe574
      import:
        name-allowlist:
          - cmsis_6
          - hal_stm32
          - libmctp
          - mbedtls
          - mcuboot
          - nanopb
          - segger
          - tf-psa-crypto
  # zephyr-keep-sorted-stop

  group-filter:
    - +optional
```
